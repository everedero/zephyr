## CMakeLists.txt
```
# SPDX-License-Identifier: Apache-2.0

cmake_minimum_required(VERSION 3.28.0)

find_package(Zephyr REQUIRED HINTS $ENV{ZEPHYR_BASE})
project(silly_sleep)

target_sources(app PRIVATE src/main.c)
zephyr_include_directories(${CMAKE_CURRENT_SOURCE_DIR}/src)
```

## sample.yaml
```
sample:
  name: silly audio (k_sleep)
  description: Silly attempt at 48 kHz audio using the Zephyr standard DAC
    driver, pacing each sample with k_sleep(K_USEC(20)). Emits a custom
    trace event at every sample iteration.
common:
  tags: dac tracing
  harness: console
  harness_config:
    type: multi_line
    regex:
      - "silly"
tests:
  sample.silly.audio.sleep:
    platform_allow: nucleo_f756zg
    depends_on: dac
```

## prj.conf
```kconfig
CONFIG_DAC=y
CONFIG_TRACING=y
CONFIG_TRACING_CUSTOM=y
CONFIG_TRACING_CTF=y
CONFIG_TRACING_BACKEND_RAM=y
CONFIG_TRACING_BUFFER_SIZE=2048
CONFIG_RAM_TRACING_BUFFER_SIZE=65536
CONFIG_TRACING_SYNC=y
```

## src/main.c
```c
/*
 * SPDX-License-Identifier: Apache-2.0
 *
 * Silly demonstration: try to generate a tone at 48 kHz using the Zephyr
 * "standard" DAC driver, pacing each sample with k_sleep(K_USEC(20)).
 * k_sleep() has coarser-than-microsecond tick granularity in practice, so
 * the achieved sample rate is astoundingly far from 48 kHz. A custom trace
 * event is emitted at every loop iteration.
 */

#include <zephyr/kernel.h>
#include <zephyr/drivers/dac.h>
#include <zephyr/tracing/tracing.h>

#include "sine.h"

#define ZEPHYR_USER_NODE DT_PATH(zephyr_user)

#define DAC_NODE        DT_PHANDLE(ZEPHYR_USER_NODE, dac)
#define DAC_CHANNEL_ID  DT_PROP(ZEPHYR_USER_NODE, dac_channel_id)
#define DAC_RESOLUTION  DT_PROP(ZEPHYR_USER_NODE, dac_resolution)

/* Nominal sample period if the sleep were accurate: 1/48 kHz ~ 20us */
#define SAMPLE_PERIOD_USEC 20U

static const struct device *const dac_dev = DEVICE_DT_GET(DAC_NODE);

static const struct dac_channel_cfg dac_ch_cfg = {
	.channel_id = DAC_CHANNEL_ID,
	.resolution = DAC_RESOLUTION,
	.buffered = true,
};

int main(void)
{
	uint32_t sample_index;

	if (!device_is_ready(dac_dev)) {
		return 0;
	}

	int ret = dac_channel_setup(dac_dev, &dac_ch_cfg);

	if (ret != 0) {
		return 0;
	}

	sample_index = 0;

	while (1) {
		/* Custom trace event at every loop iteration. */
		sys_trace_named_event("sample", sample_index, 1);
		uint16_t value =
			((wave_table[sample_index % ARRAY_SIZE(wave_table)] << 0) +
			(wave_table[(sample_index + 1) % ARRAY_SIZE(wave_table)] << 8)) >> 4;

		ret = dac_write_value(dac_dev, DAC_CHANNEL_ID, value);
		if (ret != 0) {
			return 0;
		}

//		sys_trace_named_event("sample", sample_index, 0);
		k_sleep(K_USEC(SAMPLE_PERIOD_USEC));

		sample_index++;
		sample_index++;
	}

	return 0;
}
```

## src/sine.h
```c
/*
 * SPDX-License-Identifier: Apache-2.0
 *
 * 12-bit sine wave (one period) for the "silly" audio samples.
 * Generated as value = 2048 + round(2047 * sin(2*pi*n/48)),
 * giving a 1 kHz tone when played at the ~48 kHz sample rate
 * used by the "silly" samples (48 samples per 1 kHz period).
 * Centered at mid-scale (0x800 <-> 1.65 V on a 3.3 V reference),
 * swinging across the full 0..4095 code range.
 */

#ifndef SINE_H_
#define SINE_H_

static const uint16_t wave_table[48] = {
	0x800, 0x90b, 0xa12, 0xb0f, 0xbff, 0xcde, 0xda7, 0xe58, 0xeed, 0xf63, 0xfb9, 0xfed,
	0xfff, 0xfed, 0xfb9, 0xf63, 0xeed, 0xe58, 0xda7, 0xcde, 0xbff, 0xb0f, 0xa12, 0x90b,
	0x800, 0x6f5, 0x5ee, 0x4f1, 0x401, 0x322, 0x259, 0x1a8, 0x113, 0x09d, 0x047, 0x013,
	0x001, 0x013, 0x047, 0x09d, 0x113, 0x1a8, 0x259, 0x322, 0x400, 0x4f1, 0x5ee, 0x6f5,
};

#endif /* SINE_H_ */
```

## src/zephyr_custom_tracing.h
```c
/*
 * SPDX-License-Identifier: Apache-2.0
 *
 * Custom tracing header pulled in by Zephyr when CONFIG_TRACING_CUSTOM=y.
 * It is included at the end of <zephyr/tracing/tracing.h>, before
 * tracing_hooks.h, which back-fills any undefined hook with a no-op.
 */

#ifndef ZEPHYR_CUSTOM_TRACING_H_
#define ZEPHYR_CUSTOM_TRACING_H_

/*
 * When CONFIG_TRACING_CUSTOM is selected, tracing.h does not take the default
 * branch that declares the sys_trace_isr_* / sys_trace_idle* entry points used
 * by the arch idle paths. tracing_none.c still provides their weak definitions,
 * so declare them here. This mirrors the declarations in tracing.h's default
 * branch.
 */
void sys_trace_isr_enter(void);
void sys_trace_isr_exit(void);
void sys_trace_isr_exit_to_scheduler(void);
void sys_trace_idle(void);
void sys_trace_idle_exit(void);

/*
 * The default branch of tracing.h defines these system-init hooks as no-op
 * macros; the CONFIG_TRACING_CUSTOM branch does not. Define them here so the
 * kernel init code compiles unchanged.
 */
#define sys_trace_sys_init_enter(entry, level)
#define sys_trace_sys_init_exit(entry, level, result)

/*
 * The CONFIG_TRACING_CUSTOM branch of tracing.h does not define the
 * sys_trace_named_event() API (the default branch does, as a no-op). Define it
 * here as a no-op that a tracing backend can later override. Used by the
 * "silly" audio demonstrations to emit a named event per DAC sample.
 */
#ifndef sys_trace_named_event
#define sys_trace_named_event(name, arg0, arg1) \
	do { \
		(void)(name); \
		(void)(arg0); \
		(void)(arg1); \
	} while (0)
#endif

#endif /* ZEPHYR_CUSTOM_TRACING_H_ */
```
