## CMakeLists.txt
```
# SPDX-License-Identifier: Apache-2.0

cmake_minimum_required(VERSION 3.28.0)

find_package(Zephyr REQUIRED HINTS $ENV{ZEPHYR_BASE})
project(silly_busywait)

target_sources(app PRIVATE src/main.c)
zephyr_include_directories(${CMAKE_CURRENT_SOURCE_DIR}/src)
```

## Kconfig
```
mainmenu "Silly busywait sound play"

config NO_WAIT
        bool "Do not busywait"

source "Kconfig.zephyr"
```

## sample.yaml
```
sample:
  name: silly audio (k_busy_wait)
  description: Silly attempt at 48 kHz audio using the Zephyr standard DAC
    driver, pacing each sample with k_busy_wait(20). Emits a custom trace
    event at every sample iteration. Compare achieved sample rate against the
    k_sleep variant.
common:
  tags: dac tracing
  harness: console
  harness_config:
    type: multi_line
    regex:
      - "silly"
tests:
  sample.silly.audio.busywait:
    platform_allow: nucleo_f756zg
    depends_on: dac
```

## prj.conf
```kconfig
CONFIG_DAC=y
CONFIG_TRACING=y
CONFIG_TRACING_CUSTOM=y
```

## boards/nucleo_f756zg.overlay
```dts
/*
 * SPDX-License-Identifier: Apache-2.0
 */

/ {
	zephyr,user {
		dac = <&dac1>;
		dac-channel-id = <1>;
		dac-resolution = <12>;
	};
};

&dac1 {
	pinctrl-0 = <&dac_out1_pa4>;
	pinctrl-names = "default";
	status = "okay";
};
```

## src/main.c
```c
/*
 * SPDX-License-Identifier: Apache-2.0
 *
 * Silly demonstration: try to generate a tone at 48 kHz using the Zephyr
 * "standard" DAC driver, pacing each sample with k_busy_wait(20). Unlike the
 * k_sleep variant, k_busy_wait() busy-spins for the requested microseconds,
 * so the achieved sample rate is much closer to the nominal 48 kHz. A
 * custom trace event is emitted at every loop iteration.
 */

#include <zephyr/kernel.h>
#include <zephyr/drivers/dac.h>
#include <zephyr/tracing/tracing.h>

#include "sine.h"

#define ZEPHYR_USER_NODE DT_PATH(zephyr_user)

#define DAC_NODE        DT_PHANDLE(ZEPHYR_USER_NODE, dac)
#define DAC_CHANNEL_ID  DT_PROP(ZEPHYR_USER_NODE, dac_channel_id)
#define DAC_RESOLUTION  DT_PROP(ZEPHYR_USER_NODE, dac_resolution)

/* Nominal sample period: 1/48 kHz ~ 20us */
#define SAMPLE_PERIOD_USEC 20U

static const struct device *const dac_dev = DEVICE_DT_GET(DAC_NODE);

static const struct dac_channel_cfg dac_ch_cfg = {
	.channel_id = DAC_CHANNEL_ID,
	.resolution = DAC_RESOLUTION,
	.buffered = true,
};

int main(void)
{
	uint32_t sample_index;

	if (!device_is_ready(dac_dev)) {
		return 0;
	}

	int ret = dac_channel_setup(dac_dev, &dac_ch_cfg);

	if (ret != 0) {
		return 0;
	}

	sample_index = 0;

	while (1) {
			uint16_t value =
				((wave_table[sample_index % ARRAY_SIZE(wave_table)] << 0) +
				(wave_table[(sample_index + 1) % ARRAY_SIZE(wave_table)] << 8)) >> 4;
		ret = dac_write_value(dac_dev, DAC_CHANNEL_ID, value);
		if (ret != 0) {
			return 0;
		}

		/* Custom trace event at every loop iteration. */
		sys_trace_named_event("sample", sample_index, value);
#ifndef CONFIG_NO_WAIT
		k_busy_wait(SAMPLE_PERIOD_USEC);
#endif

		sample_index++;
		sample_index++;
	}

	return 0;
}
```

## src/sine.h
```c
/*
 * SPDX-License-Identifier: Apache-2.0
 *
 * 12-bit sine wave (one period) for the "silly" audio samples.
 * Generated as value = 2048 + round(2047 * sin(2*pi*n/1600)),
 * centered at mid-scale (0x800 <-> 1.65 V on a 3.3 V reference)
 * so the DAC output swings across the full 0..4095 code range.
 */

#ifndef SINE_H_
#define SINE_H_

static const uint16_t wave_table[1600] = {
	0x800, 0x808, 0x810, 0x818, 0x820, 0x828, 0x830, 0x838, 0x840, 0x848, 0x850, 0x858,
	0x860, 0x868, 0x870, 0x879, 0x881, 0x889, 0x891, 0x899, 0x8a1, 0x8a9, 0x8b1, 0x8b9,
	0x8c1, 0x8c9, 0x8d1, 0x8d9, 0x8e1, 0x8e9, 0x8f1, 0x8f9, 0x901, 0x909, 0x910, 0x918,
	0x920, 0x928, 0x930, 0x938, 0x940, 0x948, 0x950, 0x958, 0x960, 0x968, 0x970, 0x978,
	0x980, 0x987, 0x98f, 0x997, 0x99f, 0x9a7, 0x9af, 0x9b7, 0x9bf, 0x9c6, 0x9ce, 0x9d6,
	0x9de, 0x9e6, 0x9ed, 0x9f5, 0x9fd, 0xa05, 0xa0d, 0xa14, 0xa1c, 0xa24, 0xa2c, 0xa33,
	0xa3b, 0xa43, 0xa4b, 0xa52, 0xa5a, 0xa62, 0xa69, 0xa71, 0xa79, 0xa80, 0xa88, 0xa8f,
	0xa97, 0xa9f, 0xaa6, 0xaae, 0xab5, 0xabd, 0xac5, 0xacc, 0xad4, 0xadb, 0xae3, 0xaea,
	0xaf2, 0xaf9, 0xb00, 0xb08, 0xb0f, 0xb17, 0xb1e, 0xb26, 0xb2d, 0xb34, 0xb3c, 0xb43,
	0xb4a, 0xb52, 0xb59, 0xb60, 0xb68, 0xb6f, 0xb76, 0xb7d, 0xb85, 0xb8c, 0xb93, 0xb9a,
	0xba1, 0xba8, 0xbb0, 0xbb7, 0xbbe, 0xbc5, 0xbcc, 0xbd3, 0xbda, 0xbe1, 0xbe8, 0xbef,
	0xbf6, 0xbfd, 0xc04, 0xc0b, 0xc12, 0xc19, 0xc20, 0xc27, 0xc2e, 0xc34, 0xc3b, 0xc42,
	0xc49, 0xc50, 0xc56, 0xc5d, 0xc64, 0xc6b, 0xc71, 0xc78, 0xc7f, 0xc85, 0xc8c, 0xc92,
	0xc99, 0xca0, 0xca6, 0xcad, 0xcb3, 0xcba, 0xcc0, 0xcc7, 0xccd, 0xcd3, 0xcda, 0xce0,
	0xce7, 0xced, 0xcf3, 0xcfa, 0xd00, 0xd06, 0xd0c, 0xd13, 0xd19, 0xd1f, 0xd25, 0xd2b,
	0xd31, 0xd38, 0xd3e, 0xd44, 0xd4a, 0xd50, 0xd56, 0xd5c, 0xd62, 0xd68, 0xd6e, 0xd73,
	0xd79, 0xd7f, 0xd85, 0xd8b, 0xd91, 0xd96, 0xd9c, 0xda2, 0xda7, 0xdad, 0xdb3, 0xdb8,
	0xdbe, 0xdc4, 0xdc9, 0xdcf, 0xdd4, 0xdda, 0xddf, 0xde5, 0xdea, 0xdef, 0xdf5, 0xdfa,
	0xdff, 0xe05, 0xe0a, 0xe0f, 0xe15, 0xe1a, 0xe1f, 0xe24, 0xe29, 0xe2e, 0xe33, 0xe39,
	0xe3e, 0xe43, 0xe48, 0xe4d, 0xe51, 0xe56, 0xe5b, 0xe60, 0xe65, 0xe6a, 0xe6f, 0xe73,
	0xe78, 0xe7d, 0xe81, 0xe86, 0xe8b, 0xe8f, 0xe94, 0xe99, 0xe9d, 0xea2, 0xea6, 0xeaa,
	0xeaf, 0xeb3, 0xeb8, 0xebc, 0xec0, 0xec5, 0xec9, 0xecd, 0xed1, 0xed6, 0xeda, 0xede,
	0xee2, 0xee6, 0xeea, 0xeee, 0xef2, 0xef6, 0xefa, 0xefe, 0xf02, 0xf06, 0xf09, 0xf0d,
	0xf11, 0xf15, 0xf19, 0xf1c, 0xf20, 0xf24, 0xf27, 0xf2b, 0xf2e, 0xf32, 0xf35, 0xf39,
	0xf3c, 0xf40, 0xf43, 0xf46, 0xf4a, 0xf4d, 0xf50, 0xf53, 0xf57, 0xf5a, 0xf5d, 0xf60,
	0xf63, 0xf66, 0xf69, 0xf6c, 0xf6f, 0xf72, 0xf75, 0xf78, 0xf7b, 0xf7e, 0xf80, 0xf83,
	0xf86, 0xf89, 0xf8b, 0xf8e, 0xf91, 0xf93, 0xf96, 0xf98, 0xf9b, 0xf9d, 0xfa0, 0xfa2,
	0xfa5, 0xfa7, 0xfa9, 0xfab, 0xfae, 0xfb0, 0xfb2, 0xfb4, 0xfb6, 0xfb9, 0xfbb, 0xfbd,
	0xfbf, 0xfc1, 0xfc3, 0xfc5, 0xfc6, 0xfc8, 0xfca, 0xfcc, 0xfce, 0xfcf, 0xfd1, 0xfd3,
	0xfd4, 0xfd6, 0xfd8, 0xfd9, 0xfdb, 0xfdc, 0xfde, 0xfdf, 0xfe1, 0xfe2, 0xfe3, 0xfe5,
	0xfe6, 0xfe7, 0xfe8, 0xfe9, 0xfeb, 0xfec, 0xfed, 0xfee, 0xfef, 0xff0, 0xff1, 0xff2,
	0xff3, 0xff4, 0xff4, 0xff5, 0xff6, 0xff7, 0xff7, 0xff8, 0xff9, 0xff9, 0xffa, 0xffa,
	0xffb, 0xffb, 0xffc, 0xffc, 0xffd, 0xffd, 0xffd, 0xffe, 0xffe, 0xffe, 0xffe, 0xfff,
	0xfff, 0xfff, 0xfff, 0xfff, 0xfff, 0xfff, 0xfff, 0xfff, 0xfff, 0xfff, 0xffe, 0xffe,
	0xffe, 0xffe, 0xffd, 0xffd, 0xffd, 0xffc, 0xffc, 0xffb, 0xffb, 0xffa, 0xffa, 0xff9,
	0xff9, 0xff8, 0xff7, 0xff7, 0xff6, 0xff5, 0xff4, 0xff4, 0xff3, 0xff2, 0xff1, 0xff0,
	0xfef, 0xfee, 0xfed, 0xfec, 0xfeb, 0xfe9, 0xfe8, 0xfe7, 0xfe6, 0xfe5, 0xfe3, 0xfe2,
	0xfe1, 0xfdf, 0xfde, 0xfdc, 0xfdb, 0xfd9, 0xfd8, 0xfd6, 0xfd4, 0xfd3, 0xfd1, 0xfcf,
	0xfce, 0xfcc, 0xfca, 0xfc8, 0xfc6, 0xfc5, 0xfc3, 0xfc1, 0xfbf, 0xfbd, 0xfbb, 0xfb9,
	0xfb6, 0xfb4, 0xfb2, 0xfb0, 0xfae, 0xfab, 0xfa9, 0xfa7, 0xfa5, 0xfa2, 0xfa0, 0xf9d,
	0xf9b, 0xf98, 0xf96, 0xf93, 0xf91, 0xf8e, 0xf8b, 0xf89, 0xf86, 0xf83, 0xf80, 0xf7e,
	0xf7b, 0xf78, 0xf75, 0xf72, 0xf6f, 0xf6c, 0xf69, 0xf66, 0xf63, 0xf60, 0xf5d, 0xf5a,
	0xf57, 0xf53, 0xf50, 0xf4d, 0xf4a, 0xf46, 0xf43, 0xf40, 0xf3c, 0xf39, 0xf35, 0xf32,
	0xf2e, 0xf2b, 0xf27, 0xf24, 0xf20, 0xf1c, 0xf19, 0xf15, 0xf11, 0xf0d, 0xf09, 0xf06,
	0xf02, 0xefe, 0xefa, 0xef6, 0xef2, 0xeee, 0xeea, 0xee6, 0xee2, 0xede, 0xeda, 0xed6,
	0xed1, 0xecd, 0xec9, 0xec5, 0xec0, 0xebc, 0xeb8, 0xeb3, 0xeaf, 0xeaa, 0xea6, 0xea2,
	0xe9d, 0xe99, 0xe94, 0xe8f, 0xe8b, 0xe86, 0xe81, 0xe7d, 0xe78, 0xe73, 0xe6f, 0xe6a,
	0xe65, 0xe60, 0xe5b, 0xe56, 0xe51, 0xe4d, 0xe48, 0xe43, 0xe3e, 0xe39, 0xe33, 0xe2e,
	0xe29, 0xe24, 0xe1f, 0xe1a, 0xe15, 0xe0f, 0xe0a, 0xe05, 0xdff, 0xdfa, 0xdf5, 0xdef,
	0xdea, 0xde5, 0xddf, 0xdda, 0xdd4, 0xdcf, 0xdc9, 0xdc4, 0xdbe, 0xdb8, 0xdb3, 0xdad,
	0xda7, 0xda2, 0xd9c, 0xd96, 0xd91, 0xd8b, 0xd85, 0xd7f, 0xd79, 0xd73, 0xd6e, 0xd68,
	0xd62, 0xd5c, 0xd56, 0xd50, 0xd4a, 0xd44, 0xd3e, 0xd38, 0xd31, 0xd2b, 0xd25, 0xd1f,
	0xd19, 0xd13, 0xd0c, 0xd06, 0xd00, 0xcfa, 0xcf3, 0xced, 0xce7, 0xce0, 0xcda, 0xcd3,
	0xccd, 0xcc7, 0xcc0, 0xcba, 0xcb3, 0xcad, 0xca6, 0xca0, 0xc99, 0xc92, 0xc8c, 0xc85,
	0xc7f, 0xc78, 0xc71, 0xc6b, 0xc64, 0xc5d, 0xc56, 0xc50, 0xc49, 0xc42, 0xc3b, 0xc34,
	0xc2e, 0xc27, 0xc20, 0xc19, 0xc12, 0xc0b, 0xc04, 0xbfd, 0xbf6, 0xbef, 0xbe8, 0xbe1,
	0xbda, 0xbd3, 0xbcc, 0xbc5, 0xbbe, 0xbb7, 0xbb0, 0xba8, 0xba1, 0xb9a, 0xb93, 0xb8c,
	0xb85, 0xb7d, 0xb76, 0xb6f, 0xb68, 0xb60, 0xb59, 0xb52, 0xb4a, 0xb43, 0xb3c, 0xb34,
	0xb2d, 0xb26, 0xb1e, 0xb17, 0xb0f, 0xb08, 0xb00, 0xaf9, 0xaf2, 0xaea, 0xae3, 0xadb,
	0xad4, 0xacc, 0xac5, 0xabd, 0xab5, 0xaae, 0xaa6, 0xa9f, 0xa97, 0xa8f, 0xa88, 0xa80,
	0xa79, 0xa71, 0xa69, 0xa62, 0xa5a, 0xa52, 0xa4b, 0xa43, 0xa3b, 0xa33, 0xa2c, 0xa24,
	0xa1c, 0xa14, 0xa0d, 0xa05, 0x9fd, 0x9f5, 0x9ed, 0x9e6, 0x9de, 0x9d6, 0x9ce, 0x9c6,
	0x9bf, 0x9b7, 0x9af, 0x9a7, 0x99f, 0x997, 0x98f, 0x987, 0x980, 0x978, 0x970, 0x968,
	0x960, 0x958, 0x950, 0x948, 0x940, 0x938, 0x930, 0x928, 0x920, 0x918, 0x910, 0x909,
	0x901, 0x8f9, 0x8f1, 0x8e9, 0x8e1, 0x8d9, 0x8d1, 0x8c9, 0x8c1, 0x8b9, 0x8b1, 0x8a9,
	0x8a1, 0x899, 0x891, 0x889, 0x881, 0x879, 0x870, 0x868, 0x860, 0x858, 0x850, 0x848,
	0x840, 0x838, 0x830, 0x828, 0x820, 0x818, 0x810, 0x808, 0x800, 0x7f8, 0x7f0, 0x7e8,
	0x7e0, 0x7d8, 0x7d0, 0x7c8, 0x7c0, 0x7b8, 0x7b0, 0x7a8, 0x7a0, 0x798, 0x790, 0x787,
	0x77f, 0x777, 0x76f, 0x767, 0x75f, 0x757, 0x74f, 0x747, 0x73f, 0x737, 0x72f, 0x727,
	0x71f, 0x717, 0x70f, 0x707, 0x6ff, 0x6f7, 0x6f0, 0x6e8, 0x6e0, 0x6d8, 0x6d0, 0x6c8,
	0x6c0, 0x6b8, 0x6b0, 0x6a8, 0x6a0, 0x698, 0x690, 0x688, 0x680, 0x679, 0x671, 0x669,
	0x661, 0x659, 0x651, 0x649, 0x641, 0x63a, 0x632, 0x62a, 0x622, 0x61a, 0x613, 0x60b,
	0x603, 0x5fb, 0x5f3, 0x5ec, 0x5e4, 0x5dc, 0x5d4, 0x5cd, 0x5c5, 0x5bd, 0x5b5, 0x5ae,
	0x5a6, 0x59e, 0x597, 0x58f, 0x587, 0x580, 0x578, 0x571, 0x569, 0x561, 0x55a, 0x552,
	0x54b, 0x543, 0x53b, 0x534, 0x52c, 0x525, 0x51d, 0x516, 0x50e, 0x507, 0x500, 0x4f8,
	0x4f1, 0x4e9, 0x4e2, 0x4da, 0x4d3, 0x4cc, 0x4c4, 0x4bd, 0x4b6, 0x4ae, 0x4a7, 0x4a0,
	0x498, 0x491, 0x48a, 0x483, 0x47b, 0x474, 0x46d, 0x466, 0x45f, 0x458, 0x450, 0x449,
	0x442, 0x43b, 0x434, 0x42d, 0x426, 0x41f, 0x418, 0x411, 0x40a, 0x403, 0x3fc, 0x3f5,
	0x3ee, 0x3e7, 0x3e0, 0x3d9, 0x3d2, 0x3cc, 0x3c5, 0x3be, 0x3b7, 0x3b0, 0x3aa, 0x3a3,
	0x39c, 0x395, 0x38f, 0x388, 0x381, 0x37b, 0x374, 0x36e, 0x367, 0x360, 0x35a, 0x353,
	0x34d, 0x346, 0x340, 0x339, 0x333, 0x32d, 0x326, 0x320, 0x319, 0x313, 0x30d, 0x306,
	0x300, 0x2fa, 0x2f4, 0x2ed, 0x2e7, 0x2e1, 0x2db, 0x2d5, 0x2cf, 0x2c8, 0x2c2, 0x2bc,
	0x2b6, 0x2b0, 0x2aa, 0x2a4, 0x29e, 0x298, 0x292, 0x28d, 0x287, 0x281, 0x27b, 0x275,
	0x26f, 0x26a, 0x264, 0x25e, 0x259, 0x253, 0x24d, 0x248, 0x242, 0x23c, 0x237, 0x231,
	0x22c, 0x226, 0x221, 0x21b, 0x216, 0x211, 0x20b, 0x206, 0x201, 0x1fb, 0x1f6, 0x1f1,
	0x1eb, 0x1e6, 0x1e1, 0x1dc, 0x1d7, 0x1d2, 0x1cd, 0x1c7, 0x1c2, 0x1bd, 0x1b8, 0x1b3,
	0x1af, 0x1aa, 0x1a5, 0x1a0, 0x19b, 0x196, 0x191, 0x18d, 0x188, 0x183, 0x17f, 0x17a,
	0x175, 0x171, 0x16c, 0x167, 0x163, 0x15e, 0x15a, 0x156, 0x151, 0x14d, 0x148, 0x144,
	0x140, 0x13b, 0x137, 0x133, 0x12f, 0x12a, 0x126, 0x122, 0x11e, 0x11a, 0x116, 0x112,
	0x10e, 0x10a, 0x106, 0x102, 0x0fe, 0x0fa, 0x0f7, 0x0f3, 0x0ef, 0x0eb, 0x0e7, 0x0e4,
	0x0e0, 0x0dc, 0x0d9, 0x0d5, 0x0d2, 0x0ce, 0x0cb, 0x0c7, 0x0c4, 0x0c0, 0x0bd, 0x0ba,
	0x0b6, 0x0b3, 0x0b0, 0x0ad, 0x0a9, 0x0a6, 0x0a3, 0x0a0, 0x09d, 0x09a, 0x097, 0x094,
	0x091, 0x08e, 0x08b, 0x088, 0x085, 0x082, 0x080, 0x07d, 0x07a, 0x077, 0x075, 0x072,
	0x06f, 0x06d, 0x06a, 0x068, 0x065, 0x063, 0x060, 0x05e, 0x05b, 0x059, 0x057, 0x055,
	0x052, 0x050, 0x04e, 0x04c, 0x04a, 0x047, 0x045, 0x043, 0x041, 0x03f, 0x03d, 0x03b,
	0x03a, 0x038, 0x036, 0x034, 0x032, 0x031, 0x02f, 0x02d, 0x02c, 0x02a, 0x028, 0x027,
	0x025, 0x024, 0x022, 0x021, 0x01f, 0x01e, 0x01d, 0x01b, 0x01a, 0x019, 0x018, 0x017,
	0x015, 0x014, 0x013, 0x012, 0x011, 0x010, 0x00f, 0x00e, 0x00d, 0x00c, 0x00c, 0x00b,
	0x00a, 0x009, 0x009, 0x008, 0x007, 0x007, 0x006, 0x006, 0x005, 0x005, 0x004, 0x004,
	0x003, 0x003, 0x003, 0x002, 0x002, 0x002, 0x002, 0x001, 0x001, 0x001, 0x001, 0x001,
	0x001, 0x001, 0x001, 0x001, 0x001, 0x001, 0x002, 0x002, 0x002, 0x002, 0x003, 0x003,
	0x003, 0x004, 0x004, 0x005, 0x005, 0x006, 0x006, 0x007, 0x007, 0x008, 0x009, 0x009,
	0x00a, 0x00b, 0x00c, 0x00c, 0x00d, 0x00e, 0x00f, 0x010, 0x011, 0x012, 0x013, 0x014,
	0x015, 0x017, 0x018, 0x019, 0x01a, 0x01b, 0x01d, 0x01e, 0x01f, 0x021, 0x022, 0x024,
	0x025, 0x027, 0x028, 0x02a, 0x02c, 0x02d, 0x02f, 0x031, 0x032, 0x034, 0x036, 0x038,
	0x03a, 0x03b, 0x03d, 0x03f, 0x041, 0x043, 0x045, 0x047, 0x04a, 0x04c, 0x04e, 0x050,
	0x052, 0x055, 0x057, 0x059, 0x05b, 0x05e, 0x060, 0x063, 0x065, 0x068, 0x06a, 0x06d,
	0x06f, 0x072, 0x075, 0x077, 0x07a, 0x07d, 0x080, 0x082, 0x085, 0x088, 0x08b, 0x08e,
	0x091, 0x094, 0x097, 0x09a, 0x09d, 0x0a0, 0x0a3, 0x0a6, 0x0a9, 0x0ad, 0x0b0, 0x0b3,
	0x0b6, 0x0ba, 0x0bd, 0x0c0, 0x0c4, 0x0c7, 0x0cb, 0x0ce, 0x0d2, 0x0d5, 0x0d9, 0x0dc,
	0x0e0, 0x0e4, 0x0e7, 0x0eb, 0x0ef, 0x0f3, 0x0f7, 0x0fa, 0x0fe, 0x102, 0x106, 0x10a,
	0x10e, 0x112, 0x116, 0x11a, 0x11e, 0x122, 0x126, 0x12a, 0x12f, 0x133, 0x137, 0x13b,
	0x140, 0x144, 0x148, 0x14d, 0x151, 0x156, 0x15a, 0x15e, 0x163, 0x167, 0x16c, 0x171,
	0x175, 0x17a, 0x17f, 0x183, 0x188, 0x18d, 0x191, 0x196, 0x19b, 0x1a0, 0x1a5, 0x1aa,
	0x1af, 0x1b3, 0x1b8, 0x1bd, 0x1c2, 0x1c7, 0x1cd, 0x1d2, 0x1d7, 0x1dc, 0x1e1, 0x1e6,
	0x1eb, 0x1f1, 0x1f6, 0x1fb, 0x201, 0x206, 0x20b, 0x211, 0x216, 0x21b, 0x221, 0x226,
	0x22c, 0x231, 0x237, 0x23c, 0x242, 0x248, 0x24d, 0x253, 0x259, 0x25e, 0x264, 0x26a,
	0x26f, 0x275, 0x27b, 0x281, 0x287, 0x28d, 0x292, 0x298, 0x29e, 0x2a4, 0x2aa, 0x2b0,
	0x2b6, 0x2bc, 0x2c2, 0x2c8, 0x2cf, 0x2d5, 0x2db, 0x2e1, 0x2e7, 0x2ed, 0x2f4, 0x2fa,
	0x300, 0x306, 0x30d, 0x313, 0x319, 0x320, 0x326, 0x32d, 0x333, 0x339, 0x340, 0x346,
	0x34d, 0x353, 0x35a, 0x360, 0x367, 0x36e, 0x374, 0x37b, 0x381, 0x388, 0x38f, 0x395,
	0x39c, 0x3a3, 0x3aa, 0x3b0, 0x3b7, 0x3be, 0x3c5, 0x3cc, 0x3d2, 0x3d9, 0x3e0, 0x3e7,
	0x3ee, 0x3f5, 0x3fc, 0x403, 0x40a, 0x411, 0x418, 0x41f, 0x426, 0x42d, 0x434, 0x43b,
	0x442, 0x449, 0x450, 0x458, 0x45f, 0x466, 0x46d, 0x474, 0x47b, 0x483, 0x48a, 0x491,
	0x498, 0x4a0, 0x4a7, 0x4ae, 0x4b6, 0x4bd, 0x4c4, 0x4cc, 0x4d3, 0x4da, 0x4e2, 0x4e9,
	0x4f1, 0x4f8, 0x500, 0x507, 0x50e, 0x516, 0x51d, 0x525, 0x52c, 0x534, 0x53b, 0x543,
	0x54b, 0x552, 0x55a, 0x561, 0x569, 0x571, 0x578, 0x580, 0x587, 0x58f, 0x597, 0x59e,
	0x5a6, 0x5ae, 0x5b5, 0x5bd, 0x5c5, 0x5cd, 0x5d4, 0x5dc, 0x5e4, 0x5ec, 0x5f3, 0x5fb,
	0x603, 0x60b, 0x613, 0x61a, 0x622, 0x62a, 0x632, 0x63a, 0x641, 0x649, 0x651, 0x659,
	0x661, 0x669, 0x671, 0x679, 0x680, 0x688, 0x690, 0x698, 0x6a0, 0x6a8, 0x6b0, 0x6b8,
	0x6c0, 0x6c8, 0x6d0, 0x6d8, 0x6e0, 0x6e8, 0x6f0, 0x6f7, 0x6ff, 0x707, 0x70f, 0x717,
	0x71f, 0x727, 0x72f, 0x737, 0x73f, 0x747, 0x74f, 0x757, 0x75f, 0x767, 0x76f, 0x777,
	0x77f, 0x787, 0x790, 0x798, 0x7a0, 0x7a8, 0x7b0, 0x7b8, 0x7c0, 0x7c8, 0x7d0, 0x7d8,
	0x7e0, 0x7e8, 0x7f0, 0x7f8,
};

#endif /* SINE_H_ */
```

## src/zephyr_custom_tracing.h
```c
/*
 * SPDX-License-Identifier: Apache-2.0
 *
 * Custom tracing header pulled in by Zephyr when CONFIG_TRACING_CUSTOM=y.
 * It is included at the end of <zephyr/tracing/tracing.h>, before
 * tracing_hooks.h, which back-fills any undefined hook with a no-op.
 */

#ifndef ZEPHYR_CUSTOM_TRACING_H_
#define ZEPHYR_CUSTOM_TRACING_H_

/*
 * When CONFIG_TRACING_CUSTOM is selected, tracing.h does not take the default
 * branch that declares the sys_trace_isr_* / sys_trace_idle* entry points used
 * by the arch idle paths. tracing_none.c still provides their weak definitions,
 * so declare them here. This mirrors the declarations in tracing.h's default
 * branch.
 */
void sys_trace_isr_enter(void);
void sys_trace_isr_exit(void);
void sys_trace_isr_exit_to_scheduler(void);
void sys_trace_idle(void);
void sys_trace_idle_exit(void);

/*
 * The default branch of tracing.h defines these system-init hooks as no-op
 * macros; the CONFIG_TRACING_CUSTOM branch does not. Define them here so the
 * kernel init code compiles unchanged.
 */
#define sys_trace_sys_init_enter(entry, level)
#define sys_trace_sys_init_exit(entry, level, result)

/*
 * Define a custom trace hook for the "silly" audio demonstrations. A tracing
 * backend can override it, or it can be used to hook into custom tools. The
 * #ifndef behavior in tracing_hooks.h ensures our definition wins.
 */
#ifndef sys_port_trace_silly_audio_sample
#define sys_port_trace_silly_audio_sample(sample_index, value) \
	do { \
		(void)(sample_index); \
		(void)(value); \
	} while (0)
#endif

#endif /* ZEPHYR_CUSTOM_TRACING_H_ */
```
