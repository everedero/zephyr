&qspi {
	/*pinctrl-0 = <&spi0_default>;
	pinctrl-names = "default";*/
	cs-gpios = <&piod 25 GPIO_ACTIVE_LOW>,
		   <&piod 27 GPIO_ACTIVE_LOW>;

	status = "okay";
	bme280: bme280@0 {
		spi-max-frequency = <1000000>; /* conservatively set to 1MHz */
		reg = <0>;
		compatible = "bosch,bme280";
		status = "okay";
	};
};
