#include <mem.h>
#include <st/f7/stm32f723.dtsi>

/ {
	soc {
		compatible = "st,stm32f730", "st,stm32f7", "simple-bus";

		flash-controller@40023c00 {
			flash0: flash@8000000 {
				reg = <0x08000000 DT_SIZE_K(64)>;
			};
		};
	};
};
