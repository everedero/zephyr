## drivers/audio/Kconfig.dac_sam
```kconfig
config AUDIO_CODEC_DAC_SAM
	bool "Atmel SAM DACC audio codec driver (PDC DMA)"
	depends on DT_HAS_ATMEL_SAM_DACC_AUDIO_ENABLED
	select PINCTRL
	help
	  Audio output via Atmel SAM DACC peripheral with PDC double-buffering.
	  Implements the audio_codec API with ping-pong DMA using the DACC's
	  integrated Peripheral DMA Controller (PDC).

if AUDIO_CODEC_DAC_SAM

config DAC_AUDIO_SAM_MAX_BLOCK_SAMPLES
	int "Max samples per DMA half-block"
	default 256
	range 64 4096
	help
	  Size of each half of the internal double-buffer in 16-bit samples.
	  The full buffer is twice this size.

endif # AUDIO_CODEC_DAC_SAM
```

## drivers/audio/Kconfig.dac_stm32
```kconfig
# Copyright (c) 2026 Eve Redero
# SPDX-License-Identifier: Apache-2.0

config AUDIO_CODEC_DAC_STM32
	bool "STM32 DAC audio codec driver"
	depends on DT_HAS_ST_STM32_DAC_AUDIO_ENABLED
	select DMA
	select PINCTRL
	help
	  Audio output codec using the STM32 DAC driver.

if AUDIO_CODEC_DAC_STM32

config DAC_AUDIO_STM32_DOUBLE_BUFFER
	bool "Internal double-buffer for gapless playback"
	help
	  When enabled the driver maintains an internal 2*N sample buffer and
	  runs DMA in cyclic mode. The half-transfer interrupt fires when the
	  first half finishes, giving the application a full half-period to
	  supply the next block via write() before the DMA reaches it.

config DAC_AUDIO_STM32_MAX_BLOCK_SAMPLES
	int "Maximum samples per audio half-block (double-buffer mode)"
	default 256
	range 64 4096
	depends on DAC_AUDIO_STM32_DOUBLE_BUFFER
	help
	  Size of each half of the internal double buffer in 16-bit samples.
	  Must be >= the block size (in samples) passed to the first write()
	  call. Memory cost: 2 * this_value * 2 bytes per driver instance.

endif # AUDIO_CODEC_DAC_STM32
```

## drivers/audio/Kconfig.stm32dac
```kconfig
# Copyright (c) 2026 Draeger
# SPDX-License-Identifier: Apache-2.0

config AUDIO_DAC_STM32
	bool "STM32 DAC audio playback driver"
	default y
	depends on DT_HAS_ST_STM32_DAC_AUDIO_ENABLED
	select DAC
	select COUNTER
	help
	  Enable audio playback through an STM32 on-chip DAC channel.

config AUDIO_DAC_STM32_DMA
	bool "Use DMA to feed the DAC"
	depends on AUDIO_DAC_STM32
	default y
	select DMA
	help
	  Feed the DAC from a circular DMA channel, one interrupt per
	  half-buffer. Requires a "dmas" property on the node.

	  Disable to fall back to a per-sample timer interrupt that writes
	  every sample by hand: same audio, far more CPU, which makes the
	  cost of DMA visible in a trace.

config AUDIO_DAC_STM32_TRACE_GPIO
	bool "Toggle a GPIO around the audio callbacks"
	depends on AUDIO_DAC_STM32
	select GPIO
	help
	  Drive the "trace-gpios" pin high on entry to the callback and low on
	  exit, with a single BSRR store. On a scope the pin's duty cycle is the
	  CPU cost of the callback: the same measurement the CTF markers make,
	  but without touching the trace buffer or the interrupt being measured.

	  The pin is driven active high, whatever the devicetree flags say.

config AUDIO_DAC_STM32_MAX_BLOCK_SIZE
	int "STM32 DAC audio maximum block size in bytes"
	default 512
	range 2 32766
	help
	  The driver is using double buffering: the buffer holds two blocks,
	  so the RAM cost per instance is twice this value.
```

## drivers/eeprom/Kconfig.93xx
```kconfig
# Copyright (c) 2026 Eve Redero
# SPDX-License-Identifier: Apache-2.0

config EEPROM_93XX
	bool "Microchip 93xx Microwire EEPROM"
	default y
	depends on DT_HAS_MICROCHIP_93XX_ENABLED
	select SPI
	help
	  Enable support for Microchip 93xx Microwire serial EEPROMs driven over
	  SPI. Only the x16 organisation ("B" suffix) is supported.
```

## dts/bindings/audio/atmel,sam-dacc-audio.yaml
```yaml
description: Atmel SAM DACC audio output (child node of atmel,sam-dac).

compatible: "atmel,sam-dacc-audio"

include: [pinctrl-device.yaml, base.yaml]

properties:
  atmel,timer:
    type: phandle
    required: true
    description: TC peripheral used as sample-rate trigger.

  atmel,tc-channel:
    type: int
    required: true
    description: TC channel index (0=CH0, 1=CH1, 2=CH2).

  atmel,trig-sel:
    type: int
    required: true
    description: >
      DACC_MR TRGSEL field value selecting the trigger source
      (1=TC0, 2=TC1, 3=TC2).

  pinctrl-0:
    required: true

  pinctrl-names:
    required: true
```

## dts/bindings/audio/st,stm32-dac-audio.yaml
```yaml
# Copyright (c) 2026 Draeger
# SPDX-License-Identifier: Apache-2.0

description: |
  PCM audio playback on an STM32 DAC channel, clocked by a basic timer and
  streamed by DMA (or, with CONFIG_AUDIO_DAC_STM32_DMA=n, by a per-sample
  timer interrupt).

  Example (STM32L1, DAC channel 1, TIM6, DMA1 ch2):
    audio_dac0: audio-dac {
      compatible = "st,stm32-dac-audio";
      io-channels = <&dac1 1>;
      timer = <&timers6>;
      trigger = <STM32_DAC_TRIG_TIM6>;
      dmas = <&dma1 2 (STM32_DMA_PERIPH_TX | STM32_DMA_PRIORITY_HIGH)>;
    };

compatible: "st,stm32-dac-audio"

include: base.yaml

properties:
  io-channels:
    type: phandle-array
    required: true

  timer:
    type: phandle
    required: true

  trigger:
    type: int
    required: true
    enum: [6, 7]
    description: |
      Timer TRGO source, from the STM32_DAC_TRIG_TIMx constants in
      <zephyr/dt-bindings/dac/stm32-dac.h>. Must match the timer.

  dmas:
    required: false
    description: |
      Channel used to stream samples to the DAC data register. Required
      unless CONFIG_AUDIO_DAC_STM32_DMA is disabled, in which case it is
      ignored.
```

## dts/bindings/mtd/microchip,93xx.yaml
```yaml
# Copyright (c) 2026 Eve Redero
# SPDX-License-Identifier: Apache-2.0

description: |
  Microchip 93xx Microwire ("3-wire") serial EEPROM, x16 organization.

  There are multiple vendors manufacturing serial EEPROMs compatible with the
  programming model of the Microchip 93xx, provided the least specific
  compatible entry is "microchip,93xx".

  Examples of compatible EEPROM families:
  - Microchip 93AAxx, 93LCxx, 93Cxx
  - ST M93Cxx
  - Atmel AT93Cxx
  - onsemi (Catalyst) CAT93Cxx

  Only the x16 organization is supported; the x8 organization uses a wider
  address field and a one-byte data phase, which this driver does not implement.
  Microchip and Atmel sell the organization as a part number suffix, "B" for x16
  and "A" for x8. Other parts, including the ST M93Cxx, select it with an ORG
  pin: leave that pin unconnected or tied to VCC for x16.

  CS is active high on this family. The node needs "spi-cs-high", and its entry
  in the controller's "cs-gpios" needs GPIO_ACTIVE_HIGH; the driver has a
  BUILD_ASSERT on the former because getting it wrong is the most likely
  devicetree mistake for this part.

  "address-width" is not derivable from "size": on some parts the address field
  carries a leading don't-care bit, making it one bit wider than the address
  needs. Take both values from the data sheet:

    Part      Size   address-width  Address field  READ clocks
    93xx46B    128    6             A5..A0          25
    93xx56B    256    8             X A6..A0        27
    93xx66B    512    8             A7..A0          27
    93xx76B   1024   10             X A8..A0        29
    93xx86B   2048   10             A9..A0          29

  Verified on a 93AA46B only. The other parts are untested.

compatible: "microchip,93xx"

include: ["eeprom-base.yaml", "spi-device.yaml"]

properties:
  size:
    required: true
    description: Total EEPROM size in bytes. Must be a power of two.

  address-width:
    type: int
    required: true
    description: |
      Width in bits of the address field in an instruction, from the x16
      instruction-set table of the data sheet. This is the number of address
      clocks the part expects, including any leading don't-care bit, not the
      number of bits needed to address "size".

  timeout:
    type: int
    default: 10
    description: |
      Self-timed write cycle duration in milliseconds. The default is the 10 ms
      tWC maximum of the 93AA46B (4 ms typical).
```

## dts/bindings/spi/atmel,sam-qspi.yaml
```yaml
# Copyright (c) 2018, qianfan Zhao
# SPDX-License-Identifier: Apache-2.0

description: Atmel SAM QSPI controller

compatible: "atmel,sam-qspi"

include:
  - name: spi-controller.yaml
  - name: pinctrl-device.yaml

properties:
  reg:
    required: true

  interrupts:
    required: true

  clocks:
    required: true
```

## samples/subsys/usb/dfu/boards/arduino_due.conf
```kconfig
CONFIG_MAIN_STACK_SIZE=4096
CONFIG_SYSTEM_WORKQUEUE_STACK_SIZE=3072
CONFIG_UDC_SAM_USBHS_STACK_SIZE=1024
```
