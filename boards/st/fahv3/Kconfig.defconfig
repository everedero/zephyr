## boards/st/fahv3/Kconfig.defconfig
```kconfig
# STM32F722ZE Nucleo board configuration
#
# Copyright (c) 2023 Evan Perry Grove
# SPDX-License-Identifier: Apache-2.0

if BOARD_FAHV3

config SPI_STM32_INTERRUPT
	default y
	depends on SPI

endif # BOARD_FAHV3
```

## boards/st/fahv3/Kconfig.fahv3
```kconfig
# Copyright (c) 2023 Evan Perry Grove
# SPDX-License-Identifier: Apache-2.0

config BOARD_FAHV3
	select SOC_STM32F722XX
```

## boards/st/fahv3/board.yml
```yaml
board:
  name: fahv3
  full_name: Nucleo F722ZE
  vendor: st
  socs:
    - name: stm32f730xx
```

## dts/bindings/gpio/arduino-due-header.yaml
```yaml
# Copyright (c) 2025 Eve Redero
# SPDX-License-Identifier: Apache-2.0

description: |
    GPIO pins exposed on Arduino Due headers.

    The Arduino Due layout provides four headers, one each along
    opposite edges of the board, one on bottom and one in the middle.

    Proceeding counter-clockwise:
    * An 8-pin power supply row, followed by a 16-pin analog pins row.
    * A dual-row 2*18 pin header
    * A 10-pin communication row, followed by a 12-pin digital and PWM
    pins row, followed by 4 misc pins, power and I2C.
    * A dual-row 2*4 pin header in the center with SPI bus.

    This binding provides a nexus mapping for 71 pins as depicted below:

                         SCL1  71
                         SDA1  70
                         AREF  -
                         GND   -
        -  NC            13    69
        -  IOREF         12    68
        -  RESET         11    67
        -  3V3           10    66
        -  5V             9    65
        -  GND            8    64
        -  GND            
        -  VIN            7    63
                          6    62
        0  A0             5    61
        1  A1             4    60
        2  A2             3    59
        3  A3             2    58
        4  A4             1    57
        5  A5             0    56
        6  A6
        7  A7             14   55
                          15   54
        8  A8             16   53
        9  A9             17   52
        10 A10            18   51
        11 A11            19   50
        12 DAC2           20   49
        13 DAC1           21   48
        14 CANRX
        15 CANTX

        -  GND   GND
        16 52    53 32
        17 50    51 33
        18 48    49 34
        19 46    47 35
        20 44    45 36
        21 42    43 37
        22 40    39 38
        23 38    37 39
        24 36    35 40
        25 34    33 41
        26 32    31 42
        27 30    29 43
        28 28    27 44
        29 26    25 45
        30 24    23 46
        31 22    21 47
         - 5V    5V -

compatible: "arduino-header-due"

include: [gpio-nexus.yaml, base.yaml]
```

## soc/st/stm32/stm32f7x/Kconfig.defconfig.stm32f730xx
```kconfig
# ST STM32F730XE MCU configuration options

# Copyright (c) 2018 Aurelien Jarno
# SPDX-License-Identifier: Apache-2.0

if SOC_STM32F730XX

config NUM_IRQS
	default 104

endif # SOC_STM32F730XX
```
